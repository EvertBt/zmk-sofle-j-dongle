## boards/shields/eyelash_sofle_dongle_halcyon/Kconfig.defconfig
```kconfig
# Copyright (c) 2026 The ZMK Contributors
# SPDX-License-Identifier: MIT

if SHIELD_EYELASH_SOFLE_DONGLE_HALCYON

config ZMK_KEYBOARD_NAME
    default "Sofle-J Dongle"

config ZMK_SPLIT_ROLE_CENTRAL
    default y

config ZMK_SPLIT
    default y

config ZMK_BLE
    default y

endif
```

## boards/shields/eyelash_sofle_dongle_halcyon/Kconfig.shield
```kconfig
# Copyright (c) 2026 The ZMK Contributors
# SPDX-License-Identifier: MIT

config SHIELD_EYELASH_SOFLE_DONGLE_HALCYON
    def_bool $(shields_list_contains,eyelash_sofle_dongle_halcyon)

# Halcyon dongle defconfig compatibility symbols
config ZMK_EXT_POWER_START
    bool
    default n

config ZMK_BLE_PROFILE_ADVERTISING
    bool
    default n
```
